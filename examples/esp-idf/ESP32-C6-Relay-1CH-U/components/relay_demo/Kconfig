## examples/esp-idf/ESP32-C6-Relay-1CH-U/components/relay_demo/Kconfig
```kconfig
menu "ESP32-CX-Relay-1CH-U demo configuration"

    choice RELAY_DEMO_MODE
        prompt "Demo mode"
        default RELAY_DEMO_MODE_WIFI_AP

        config RELAY_DEMO_MODE_WIFI_AP
            bool "Wi-Fi AP + Web"

        config RELAY_DEMO_MODE_WIFI_STA
            bool "Wi-Fi STA + Web"
    endchoice

    config RELAY_DEMO_STA_SSID
        string "Wi-Fi station SSID"
        default ""

    config RELAY_DEMO_STA_PASSWORD
        string "Wi-Fi station password"
        default ""

    config RELAY_DEMO_AP_SSID
        string "Wi-Fi access point SSID"
        default "ESP32-C6-Relay-1CH-U"

    config RELAY_DEMO_AP_PASSWORD
        string "Wi-Fi access point password"
        default "12345678"

endmenu
```

## examples/esp-idf/ESP32-C6-Relay-1CH-U/sdkconfig.defaults
```kconfig
CONFIG_ESP_CONSOLE_USB_SERIAL_JTAG=y
CONFIG_BT_ENABLED=y
CONFIG_BT_NIMBLE_ENABLED=y
CONFIG_PARTITION_TABLE_CUSTOM=y
CONFIG_PARTITION_TABLE_CUSTOM_FILENAME="partitions.csv"
CONFIG_IDF_TARGET="esp32c6"
CONFIG_RELAY_DEMO_AP_SSID="ESP32-C6-Relay-1CH-U"
CONFIG_RELAY_DEMO_AP_PASSWORD="waveshare"
CONFIG_RELAY_DEMO_MODE_WIFI_AP=y
# CONFIG_RELAY_DEMO_MODE_WIFI_STA is not set
```
